## CareRover_Demo_Signal_Optimization_Handoff_2026-09-15_clean(1)/firmware/cam_tracking/main/Kconfig.projbuild
```kconfig
menu "CareRover CAM"
config CAREROVER_FACE
    bool "Enable face detection"
    default y
config CAREROVER_VIDEO
    bool "Enable wireless MJPEG"
    default y
config CAREROVER_PICO_FACE
    bool "Use Pico 224 instead of MSR/MNP"
    default n
config CAREROVER_WIFI_SSID
    string "Main controller AP SSID"
    default "CareRover-XXXX"
config CAREROVER_WIFI_PASSWORD
    string "Main controller AP password"
    default "COMPILE_CHECK_ONLY"
endmenu
```
